## configs/epass_t113_tf_defconfig
```kconfig
# T113-S3 Buildroot 配置文件
# 用于 TF 卡启动的 Electronic Pass 项目

# ========== 目标架构 ==========
BR2_arm=y
BR2_cortex_a7=y
BR2_ARM_FPU_VFPV4=y
BR2_ARM_ENABLE_NEON=y
BR2_ARM_ENABLE_VFP=y

# ========== 系统配置 ==========
BR2_TARGET_GENERIC_HOSTNAME="t113-epass"
BR2_TARGET_GENERIC_ISSUE="T113-S3 Electronic Pass - Arknights 2019.04.30"
BR2_SYSTEM_DHCP=""
BR2_ROOTFS_DEVICE_CREATION_DYNAMIC_EUDEV=y
BR2_ROOTFS_DEVICE_CREATION_STATIC=y

# ========== 串口控制台 ==========
BR2_TARGET_GENERIC_GETTY=y
BR2_TARGET_GENERIC_GETTY_PORT="ttyS0"
BR2_TARGET_GENERIC_GETTY_BAUDRATE_115200=y
BR2_TARGET_GENERIC_ROOT_PASSWD="1234"
BR2_TARGET_GENERIC_REMOUNT_ROOTFS_RW=y

# ========== Linux Kernel ==========
BR2_LINUX_KERNEL=y
BR2_LINUX_KERNEL_CUSTOM_VERSION=y
BR2_LINUX_KERNEL_CUSTOM_VERSION_VALUE="5.16"
BR2_LINUX_KERNEL_USE_ARCH_DEFAULT_CONFIG=y
BR2_LINUX_KERNEL_DEFCONFIG="sunxi"
BR2_LINUX_KERNEL_CONFIG_FRAGMENT_FILES="board/allwinner/t113-epass/linux.fragment"
BR2_LINUX_KERNEL_DTS_SUPPORT=y
BR2_LINUX_KERNEL_INTREE_DTS_NAME="sun8i-t113-s3-epass-tf"
BR2_LINUX_KERNEL_INSTALL_TARGET=y

# ========== U-Boot ==========
BR2_TARGET_UBOOT=y
BR2_TARGET_UBOOT_BUILD_SYSTEM_KCONFIG=y
BR2_TARGET_UBOOT_CUSTOM_VERSION=y
BR2_TARGET_UBOOT_CUSTOM_VERSION_VALUE="2022.10"
BR2_TARGET_UBOOT_BOARD_DEFCONFIG="mangopi-dual-t113"
BR2_TARGET_UBOOT_NEEDS_DTC=y
BR2_TARGET_UBOOT_SPL=y
BR2_TARGET_UBOOT_FORMAT_BIN=y
BR2_TARGET_UBOOT_SPL_NAME="u-boot-sunxi-with-spl.bin"
BR2_TARGET_UBOOT_CUSTOM_CONFIG_FILE="board/allwinner/t113-epass/uboot.defconfig"
BR2_TARGET_UBOOT_CUSTOM_DTS_PATH="board/allwinner/t113-epass/device-tree/sun8i-t113-s3-epass-tf.dts"

# ========== 必需软件包 ==========
# 文件系统工具
BR2_PACKAGE_E2FSPROGS=y
BR2_PACKAGE_E2FSPROGS_RESIZE2FS=y
BR2_PACKAGE_E2FSPROGS_TUNE2FS=y

# DRM 显示支持
BR2_PACKAGE_LIBDRM=y

# USB 工具
BR2_PACKAGE_USBUTILS=y

# WiFi 固件（根据实际情况调整）
BR2_PACKAGE_FIRMWARE_LINUX=y
BR2_PACKAGE_WIRELESS_REGDB=y
BR2_PACKAGE_IW=y
BR2_PACKAGE_WPA_SUPPLICANT=y

# ========== 文件系统镜像 ==========
BR2_TARGET_ROOTFS_TAR=y
BR2_TARGET_ROOTFS_EXT2=y
BR2_TARGET_ROOTFS_EXT2_4=y
BR2_TARGET_ROOTFS_EXT2_SIZE="200M"
```
